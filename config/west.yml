## config/west.yml
```yaml
manifest:
  remotes:
  - name: zmkfirmware
    url-base: https://github.com/zmkfirmware
  projects:
  - name: zmk
    remote: zmkfirmware
    revision: v0.3
    import: app/west.yml
  - name: zmk-locales
    url: https://github.com/joelspadin/zmk-locales
    revision: main
    path: modules/zmk-locales
  - name: zmk-helpers
    url: https://github.com/urob/zmk-helpers
    revision: v0.3 # Match the ZMK release.
    path: modules/zmk-helpers
  self:
    path: config
```
